## CMakeLists.txt
```
# SPDX-License-Identifier: Apache-2.0

cmake_minimum_required(VERSION 3.20.0)

find_package(Zephyr REQUIRED HINTS $ENV{ZEPHYR_BASE})
project(hubble-demo-app)

target_sources(app PRIVATE src/main.c)
target_sources_ifdef(CONFIG_HUBBLE_TIME_SYNC app PRIVATE src/bt_time_service.c)
```

## Kconfig
```
# Copyright (c) 2024 HubbleNetwork
# SPDX-License-Identifier: Apache-2.0
#
# This file is the application Kconfig entry point. All application Kconfig
# options can be defined here or included via other application Kconfig files.
# You can browse these options using the west targets menuconfig (terminal) or
# guiconfig (GUI).

menu "Zephyr"
source "Kconfig.zephyr"
endmenu

config HUBBLE_TIME_SYNC
	   bool "Use Hubble UUID to time sync service"
	   help
		Enable a service to sync time with Hubble Connect App

module = APP
module-str = APP
source "subsys/logging/Kconfig.template.log_config"
```

## prj.conf
```kconfig
# Reasonable SHELL configuration for this application
CONFIG_SHELL=n

# Logging
CONFIG_LOG=n

# Hubble Network
CONFIG_HUBBLE_BLE_NETWORK=y
CONFIG_HUBBLE_COUNTER_SOURCE_DEVICE_UPTIME=y

# Bluetooth dependencies
CONFIG_BT=y
CONFIG_BT_BROADCASTER=y

CONFIG_MAIN_STACK_SIZE=2048
```

## boards/nrf52840dk_nrf52840.conf
```kconfig
# Necessary to set TX power on the Nordic boards
CONFIG_BT_LL_SW_SPLIT=y
CONFIG_BT_CTLR_TX_PWR_PLUS_4=y
CONFIG_SERIAL=n
```

## boards/nrf52840dk_nrf52840.overlay
```dts
&uart0 {
    status = "disabled";
};
```

## src/main.c
```c
#include <hubble/hubble.h>
#include <zephyr/kernel.h>
#include <zephyr/bluetooth/bluetooth.h>
#include <zephyr/kernel.h>
#include <zephyr/logging/log.h>
#include <zephyr/drivers/gpio.h>

#include <stdint.h>
#include <stdlib.h>

#include "key.c"
#include "utc.c"

LOG_MODULE_REGISTER(main, CONFIG_APP_LOG_LEVEL);


#define ADV_UPDATE_PERIOD_S 300

/* Advertising interval settings */
#define ADV_INTERVAL_S 2
#define ADV_INTERVAL_CNT_MIN (ADV_INTERVAL_S * 1600)
#define ADV_INTERVAL_CNT_MAX (ADV_INTERVAL_S * 2000)

/* Blink settings */
#define BLINK_PERIOD_MS (ADV_INTERVAL_S * 1000)
#define BLINK_ONTIME_MS 100
#define BLINK_OFFTIME_MS (BLINK_PERIOD_MS - BLINK_ONTIME_MS)


/* The devicetree node identifier for the "led0" alias. */
#define LED0_NODE DT_ALIAS(led0)

// Buffer used for Hubble data
// Encrypted data will go in here for the advertisement.
#define HUBBLE_USER_BUFFER_LEN 31
static uint8_t _hubble_user_buffer[HUBBLE_USER_BUFFER_LEN];

/*
 * A build error on this line means your board is unsupported.
 * See the sample documentation for information on how to fix this.
 */
static const struct gpio_dt_spec led = GPIO_DT_SPEC_GET(LED0_NODE, gpios);

static uint16_t app_adv_uuids[1] = {
	HUBBLE_BLE_UUID,
};

static struct bt_data app_ad[2] = {
	BT_DATA(BT_DATA_UUID16_ALL, &app_adv_uuids, sizeof(app_adv_uuids)),
	{},
};

K_SEM_DEFINE(timer_sem, 0, 1);

static void timer_cb(struct k_timer *timer)
{
	k_sem_give(&timer_sem);
}

K_TIMER_DEFINE(message_timer, timer_cb, NULL);

static void blink_timer_cb(struct k_timer *timer)
{
	static bool led_state = false;
	k_timeout_t next = led_state ? K_MSEC(BLINK_OFFTIME_MS) : K_MSEC(BLINK_ONTIME_MS);
	led_state = !led_state;
	gpio_pin_set_dt(&led, led_state);
	k_timer_start(timer, next, K_NO_WAIT);
}
K_TIMER_DEFINE(blink_timer, blink_timer_cb, NULL);

int main(void)
{
	int err;

	if (!gpio_is_ready_dt(&led)) {
		return 0;
	}

	err = gpio_pin_configure_dt(&led, GPIO_OUTPUT_ACTIVE);
	if (err < 0) {
		return err;
	}

	LOG_DBG("Hubble Network BLE Beacon started");

	/* Synchrounosly initialize the Bluetooth subsystem. */
	err = bt_enable(NULL);
	if (err != 0) {
		LOG_ERR("Bluetooth init failed (err %d)", err);
		return err;
	}

	err = hubble_init(utc_time, master_key);
	if (err != 0) {
		LOG_ERR("Failed to initialize Hubble BLE Network");
		goto end;
	}

	/* Blink an LED as a "proof of life" */
	k_timer_start(&blink_timer, K_NO_WAIT, K_NO_WAIT);

	/* Update the message we send every ADV_UPDATE_PERIOD_S */
	k_timer_start(
		&message_timer,
		K_SECONDS(ADV_UPDATE_PERIOD_S),
		K_SECONDS(ADV_UPDATE_PERIOD_S));

	while (1) {
		size_t out_len = HUBBLE_USER_BUFFER_LEN;
		err = hubble_ble_advertise_get(NULL, 0, _hubble_user_buffer, &out_len);
		if (err != 0) {
			LOG_ERR("Failed to get the advertisement data");
			goto end;
		}
		app_ad[1].data_len = out_len;
		app_ad[1].type = BT_DATA_SVC_DATA16;
		app_ad[1].data = _hubble_user_buffer;

		LOG_DBG("Number of bytes in advertisement: %d", out_len);

		err = bt_le_adv_start(BT_LE_ADV_PARAM(BT_LE_ADV_OPT_USE_NRPA,
					      ADV_INTERVAL_CNT_MIN,
					      ADV_INTERVAL_CNT_MAX, NULL),
				      app_ad, ARRAY_SIZE(app_ad), NULL, 0);
		if (err != 0) {
			LOG_ERR("Bluetooth advertisement failed (err %d)", err);
			goto end;
		}

		k_sem_take(&timer_sem, K_FOREVER);

		err = bt_le_adv_stop();
		if (err != 0) {
			LOG_ERR("Bluetooth advertisement stop failed (err %d)",
				err);
			goto end;
		}
	}

end:
	(void)bt_disable();
	return err;
}
```

## src/bt_time_service.c
```c
/*
 * Copyright (c) 2025 Hubble Network, Inc.
 *
 * SPDX-License-Identifier: Apache-2.0
 */

#include <zephyr/bluetooth/bluetooth.h>
#include <zephyr/bluetooth/hci.h>
#include <zephyr/bluetooth/conn.h>
#include <zephyr/bluetooth/uuid.h>
#include <zephyr/bluetooth/gatt.h>

#define HUBBLE_BLE_UUID_CONNECTABLE 0xFCA7

/* Time sync protocol */
#define PKT_CMD              0x02
#define PKT_CMD_SETUTC       0x02
#define PKT_CMD_SETEPHEMERIS 0x07

#define TIME_SYNC_SVC_UUID         \
	BT_UUID_128_ENCODE(0xef2dc9a1, 0x40be, 0x44b6, 0x9dda, 0x8a00fcd61dc0)
#define TIME_SYNC_CHR_UUID         \
	BT_UUID_128_ENCODE(0xef2dc9a1, 0x40be, 0x44b6, 0x9dda, 0x8a00fcd61dc1)

static struct bt_data connect_ad[] = {
	BT_DATA_BYTES(BT_DATA_UUID16_ALL,
		      BT_UUID_16_ENCODE(HUBBLE_BLE_UUID_CONNECTABLE)),
	BT_DATA_BYTES(BT_DATA_SVC_DATA16,
		      BT_UUID_16_ENCODE(HUBBLE_BLE_UUID_CONNECTABLE)),
};

K_SEM_DEFINE(init_sem, 0, 1);

static uint64_t current_time;

static const struct bt_uuid_128 time_sync_svc_uuid = BT_UUID_INIT_128(TIME_SYNC_SVC_UUID);
static const struct bt_uuid_128 time_sync_chr_uuid = BT_UUID_INIT_128(TIME_SYNC_CHR_UUID);

static void _adv_provisioning_work_handler(struct k_work *work)
{
	ARG_UNUSED(work);

	(void)bt_le_adv_start(BT_LE_ADV_PARAM(BT_LE_ADV_OPT_USE_NRPA | BT_LE_ADV_OPT_CONN,
					       BT_GAP_ADV_FAST_INT_MIN_2,
					       BT_GAP_ADV_FAST_INT_MAX_2, NULL),
			       connect_ad, ARRAY_SIZE(connect_ad), NULL, 0);
}

int64_t bt_time_sync(k_timeout_t timeout)
{
	int ret;

	ret = bt_le_adv_start(BT_LE_ADV_PARAM(BT_LE_ADV_OPT_USE_NRPA | BT_LE_ADV_OPT_CONN,
					       BT_GAP_ADV_FAST_INT_MIN_2,
					       BT_GAP_ADV_FAST_INT_MAX_2, NULL),
			      connect_ad, ARRAY_SIZE(connect_ad), NULL, 0);
	if (ret != 0) {
		return ret;
	}

	ret = k_sem_take(&init_sem, timeout);

	bt_le_adv_stop();

	return ret != 0 ? ret : (int64_t)current_time;
}

K_WORK_DEFINE(provisioning_work, _adv_provisioning_work_handler);

static ssize_t _time_sync_chr_write_cb(struct bt_conn *conn, const struct bt_gatt_attr *attr,
				      const void *data, uint16_t len, uint16_t offset, uint8_t flags)
{
	int ret = -EINVAL;

	if (((uint8_t *)data)[0] != PKT_CMD) {
		return -ENOENT;
	}

	switch (((uint8_t *)data)[1]) {
	case PKT_CMD_SETUTC:
		if (len != (2 + sizeof(uint64_t))) {
			break;
		}
		memcpy(&current_time, &((uint8_t *)data)[2], sizeof(current_time));
		ret = len;
	case PKT_CMD_SETEPHEMERIS:
		/* Needed by Hubble Connect APP */
		ret = len;
		break;
	default:
		break;
	}

	return ret;
}

static void _disconnected_cb(struct bt_conn *conn, uint8_t reason)
{
	ARG_UNUSED(conn);
	ARG_UNUSED(reason);

	if (current_time != 0) {
		k_sem_give(&init_sem);
	} else {
		k_work_submit(&provisioning_work);
	}
}

BT_CONN_CB_DEFINE(conn_callbacks) = {
	.disconnected = _disconnected_cb,
};

/* Check for BT_GATT_PERM_WRITE_LESC permissions */
BT_GATT_SERVICE_DEFINE(vnd_svc,
	BT_GATT_PRIMARY_SERVICE(&time_sync_svc_uuid),
	BT_GATT_CHARACTERISTIC(&time_sync_chr_uuid.uuid,
			       BT_GATT_CHRC_WRITE | BT_GATT_CHRC_WRITE_WITHOUT_RESP,
			       BT_GATT_PERM_WRITE,
			       NULL, _time_sync_chr_write_cb, NULL),
		      );
```

## src/bt_time_service.h
```c
/*
 * Copyright (c) 2025 Hubble Network, Inc.
 *
 * SPDX-License-Identifier: Apache-2.0
 */

#include <zephyr/kernel.h>


/**
 * @brief BLE service for time sync.
 *
 * This function advertises Hubble UUID and waits (synchronously)
 * for a connection with Hubble Connect APP to sync time.
 *
 * @param timeout The amount of time to wait for time synchronization.
 * @return UTC time  on success or (negative) error code otherwise.
 */
int64_t bt_time_sync(k_timeout_t timeout);
```
