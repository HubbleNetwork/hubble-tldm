## CMakeLists.txt
```
# SPDX-License-Identifier: Apache-2.0

cmake_minimum_required(VERSION 3.20.0)

find_package(Zephyr REQUIRED HINTS $ENV{ZEPHYR_BASE})
project(hubble-sat-app)

target_sources(app PRIVATE src/main.c)
```

## Kconfig
```
# Copyright (c) 2026 HubbleNetwork
# SPDX-License-Identifier: Apache-2.0
#
# This file is the application Kconfig entry point. All application Kconfig
# options can be defined here or included via other application Kconfig files.
# You can browse these options using the west targets menuconfig (terminal) or
# guiconfig (GUI).

config APP_SAT_TX_INTERVAL_SECONDS
	int "Inter-transmission sleep in seconds"
	default 10
	help
	  Time the application sleeps between consecutive satellite packet
	  transmissions, in seconds.

	  Because packets are sent with HUBBLE_SAT_RELIABILITY_NONE, the send
	  call does not block on a retry sequence, so this is also the
	  effective packet rate. At the default of 10 a board transmits about
	  8,600 packets a day; raise it to put less traffic on the network.

menu "Zephyr"
source "Kconfig.zephyr"
endmenu

module = APP
module-str = APP
source "subsys/logging/Kconfig.template.log_config"
```

## prj.conf
```kconfig
# Reasonable SHELL configuration for this application
CONFIG_SHELL=n

# Logging
CONFIG_LOG=n

# Hubble Network
CONFIG_HUBBLE_SAT_NETWORK=y
CONFIG_HUBBLE_COUNTER_SOURCE_DEVICE_UPTIME=y

# Disable nonce-reuse enforcement. The check persists the sequence counter to
# NVS and rejects reused/decreasing counters; this application transmits
# continuously and needs no NVS.
CONFIG_HUBBLE_NETWORK_SECURITY_ENFORCE_NONCE_CHECK=n

CONFIG_MAIN_STACK_SIZE=4096
```

## src/main.c
```c
/*
 * Copyright (c) 2026 Hubble Network, Inc.
 * SPDX-License-Identifier: Apache-2.0
 */

#include <hubble/hubble.h>
#include <hubble/sat.h>
#include <hubble/sat/packet.h>

#include <zephyr/kernel.h>
#include <zephyr/logging/log.h>
#include <zephyr/sys/byteorder.h>

#include <stdint.h>

#include "key.c"

LOG_MODULE_REGISTER(main, CONFIG_APP_LOG_LEVEL);

/*
 * Payload is the device uptime in seconds, big-endian. hubble_sat_packet_get()
 * only accepts lengths of 0, 4, 9 or 13 bytes and rejects anything else with
 * -EINVAL, so this is the smallest non-empty payload the protocol allows.
 */
#define PAYLOAD_LEN 4U

int main(void)
{
	struct hubble_sat_packet pkt;
	uint8_t payload[PAYLOAD_LEN];
	int err;

	LOG_DBG("Hubble Network Satellite application started");

	/*
	 * Uses the device uptime counter source
	 * (CONFIG_HUBBLE_COUNTER_SOURCE_DEVICE_UPTIME), so no UTC time is
	 * needed: the initial EID counter is 0 and advances with uptime.
	 */
	err = hubble_init(0, master_key);
	if (err != 0) {
		LOG_ERR("Failed to initialize Hubble Sat Network");
		return err;
	}

	while (1) {
		sys_put_be32((uint32_t)(k_uptime_get() / MSEC_PER_SEC), payload);

		err = hubble_sat_packet_get(&pkt, payload, sizeof(payload));
		if (err != 0) {
			LOG_ERR("Failed to get Hubble Sat Network packet");
			return err;
		}

		/* NONE sends the packet once, with no retries. */
		err = hubble_sat_packet_send(&pkt, HUBBLE_SAT_RELIABILITY_NONE);
		if (err != 0) {
			LOG_ERR("Failed to transmit packet");
			return err;
		}

		k_sleep(K_SECONDS(CONFIG_APP_SAT_TX_INTERVAL_SECONDS));
	}

	return 0;
}
```

## src/key.c
```c
__attribute__((used, retain)) static uint8_t master_key[CONFIG_HUBBLE_KEY_SIZE] = {1};
```
