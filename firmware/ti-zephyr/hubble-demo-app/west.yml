## firmware/ti-zephyr/hubble-demo-app/west.yml
```yaml
# Copyright (c) 2024 HubbleNetwork
# SPDX-License-Identifier: Apache-2.0

manifest:

  remotes:
    - name: simplelink-zephyr
      url-base: https://github.com/TexasInstruments
    - name: hubble
      url-base: https://github.com/HubbleNetwork


  projects:
    - name: simplelink-zephyr
      remote: simplelink-zephyr
      revision: v3.7.0-ti-9.14.00_ea
      path: zephyr
      import: true
      west-commands: scripts/west-commands.yml
    - name: hubblenetwork-sdk
      repo-path: sdk
      revision: v1.0.0
      path: modules/lib/hubblenetwork-sdk
      remote: hubble
```
